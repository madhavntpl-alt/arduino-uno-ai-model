/*
 * UNO-MIND — Offline Local Language Model for Arduino Uno
 * 
 * Single-file firmware implementation.
 * Model weights in model_data.h (generated by training pipeline).
 * 
 * Hardware: Arduino Uno (ATmega328P)
 * 16 MHz | 2 KB SRAM | 32 KB Flash
 * 
 * Architecture: Byte-level tokenizer + Fixed-context MLP (INT8 quantized)
 * Inference: Autoregressive next-token prediction, greedy decoding
 */

// ============================================================
// CONFIGURATION & INCLUDES
// ============================================================

#include <avr/pgmspace.h>
#include <avr/wdt.h>
#include <string.h>
#include <stdint.h>
#include <stdlib.h>

// Model data (generated by export_arduino.py)
#include "model_data.h"

// Compile-time constants (fallback if model_data.h not present)
#ifndef VOCAB_SIZE
  #define VOCAB_SIZE 256
  #define EMBED_DIM 16
  #define CONTEXT_WINDOW 8
  #define HIDDEN_DIM 32
  #define INPUT_DIM (CONTEXT_WINDOW * EMBED_DIM)
  #define TIE_WEIGHTS 0
  #define TOKEN_BOS 255
  #define TOKEN_EOS 254
  #warning "model_data.h not found - using default config"
#endif

// Hardware limits
#define SERIAL_BAUD 115200
#define MAX_INPUT_CHARS 128
#define MAX_OUTPUT_TOKENS 128
#define REPETITION_PENALTY 15  // Logit penalty for repeated tokens
#define REPETITION_WINDOW 8    // Track last N tokens for penalty

// SRAM Buffers (statically allocated)
static char input_buffer[MAX_INPUT_CHARS + 1];
static uint8_t token_context[CONTEXT_WINDOW];
static uint8_t repetition_history[REPETITION_WINDOW];
static uint8_t rep_hist_len = 0;
static uint8_t rep_hist_pos = 0;

// Inference buffers (INT16/INT32 for accumulation)
static int16_t embedding_scratch[CONTEXT_WINDOW * EMBED_DIM];
static int16_t flattened_input[INPUT_DIM];
static int32_t hidden_accum[HIDDEN_DIM];
static int8_t hidden_activations[HIDDEN_DIM];
static int32_t output_logits[VOCAB_SIZE];

// Runtime state
static bool model_loaded = false;
static uint16_t total_tokens_generated = 0;
static uint32_t inference_cycles = 0;

// ============================================================
// UTILITY FUNCTIONS
// ============================================================

// Clamped ReLU for INT8: max(0, min(127, x))
static inline int8_t relu_int8(int32_t x) {
  if (x <= 0) return 0;
  if (x >= 127) return 127;
  return (int8_t)x;
}

// Saturating add for INT32
static inline int32_t sat_add32(int32_t a, int32_t b) {
  int32_t res = a + b;
  // Overflow check not needed for our ranges, but kept for safety
  return res;
}

// Free RAM measurement
static int freeRam() {
  extern int __heap_start, *__brkval;
  int v;
  return (int)&v - (__brkval == 0 ? (int)&__heap_start : (int)__brkval);
}

// Stack usage estimation (fill pattern)
static uint16_t checkStack() {
  uint16_t count = 0;
  uint8_t *p = (uint8_t*)RAMEND;
  while (p > (uint8_t*)&count && *p == 0x55) {
    p--;
    count++;
  }
  return count;
}

// ============================================================
// TOKENIZER (Byte-level)
// ============================================================

// Tokenize input string into context buffer
// Returns number of tokens written (including BOS/EOS)
static uint8_t tokenize(const char* input, uint8_t* output, uint8_t max_tokens) {
  uint8_t len = 0;
  output[len++] = TOKEN_BOS;
  
  while (*input && len < max_tokens - 1) {
    // Byte-level: each UTF-8 byte becomes a token
    output[len++] = (uint8_t)(*input++);
  }
  
  output[len++] = TOKEN_EOS;
  return len;
}

// Decode single token to serial output
static void detokenize(uint8_t token) {
  if (token < 254) {  // Regular byte (not BOS/EOS)
    Serial.write(token);
  }
}

// ============================================================
// MODEL INFERENCE (INT8 Quantized)
// ============================================================

// Embedding lookup: token_id -> EMBED_DIM values (dequantized to INT16)
// Reads from PROGMEM, applies scale
static void embedding_lookup(uint8_t token_id, int16_t* out) {
  const int8_t* row = (const int8_t*)pgm_read_ptr(&EMBEDDING_TABLE[token_id]);
  // EMBEDDING_TABLE is 2D array in PROGMEM
  // Need to compute offset manually for PROGMEM
  const int8_t* base = (const int8_t*)EMBEDDING_TABLE;
  const int8_t* src = base + token_id * EMBED_DIM;
  
  float scale = pgm_read_float(&EMBEDDING_SCALE);
  for (uint8_t i = 0; i < EMBED_DIM; i++) {
    int8_t w = pgm_read_byte(src + i);
    out[i] = (int16_t)(w * scale);
  }
}

// Build flattened input vector from token context
// context: [CONTEXT_WINDOW] token IDs
// out: [INPUT_DIM] INT16 values
static void build_flattened_input(const uint8_t* context, int16_t* out) {
  for (uint8_t t = 0; t < CONTEXT_WINDOW; t++) {
    embedding_lookup(context[t], embedding_scratch + t * EMBED_DIM);
  }
  // Copy to flattened input (already in embedding_scratch)
  memcpy(out, embedding_scratch, INPUT_DIM * sizeof(int16_t));
}

// Hidden layer: INT16 input * INT8 weights -> INT32 accum -> ReLU -> INT8
// Input: [INPUT_DIM] INT16
// Output: [HIDDEN_DIM] INT8 activations (in hidden_activations)
static void hidden_layer(const int16_t* input) {
  const int8_t* weights = (const int8_t*)HIDDEN_WEIGHTS;
  float w_scale = pgm_read_float(&HIDDEN_WEIGHT_SCALE);
  float b_scale = pgm_read_float(&HIDDEN_BIAS_SCALE);
  
  for (uint8_t j = 0; j < HIDDEN_DIM; j++) {
    int32_t acc = 0;
    const int8_t* w_row = weights + j * INPUT_DIM;
    
    // Dot product: input (INT16) * weights (INT8) -> INT32
    for (uint8_t i = 0; i < INPUT_DIM; i++) {
      int16_t in_val = input[i];
      int8_t w_val = pgm_read_byte(w_row + i);
      acc += (int32_t)in_val * (int32_t)w_val;
    }
    
    // Apply weight scale
    acc = (int32_t)(acc * w_scale);
    
    // Add bias (INT32)
    int32_t bias = (int32_t)pgm_read_dword(&HIDDEN_BIAS[j]) * b_scale;
    acc += bias;
    
    // ReLU + clamp to INT8
    hidden_activations[j] = relu_int8(acc);
  }
}

// Output layer: INT8 hidden * INT8 weights -> INT32 logits
// Output: [VOCAB_SIZE] INT32 logits
static void output_layer() {
  float w_scale, b_scale;
  const int8_t* weights;
  
  if (TIE_WEIGHTS) {
    // Tied: output weights = embedding table transposed
    // We need: hidden (HIDDEN_DIM) * embedding^T (EMBED_DIM x VOCAB_SIZE)
    // But HIDDEN_DIM may != EMBED_DIM. For simplicity, assume equal or use projection.
    // This implementation assumes HIDDEN_DIM == EMBED_DIM for tied weights.
    weights = (const int8_t*)EMBEDDING_TABLE;  // [VOCAB_SIZE][EMBED_DIM]
    w_scale = pgm_read_float(&EMBEDDING_SCALE);
  } else {
    weights = (const int8_t*)OUTPUT_WEIGHTS;
    w_scale = pgm_read_float(&OUTPUT_WEIGHT_SCALE);
  }
  b_scale = pgm_read_float(&OUTPUT_BIAS_SCALE);
  
  for (uint16_t v = 0; v < VOCAB_SIZE; v++) {
    int32_t acc = 0;
    const int8_t* w_row;
    
    if (TIE_WEIGHTS) {
      // Embedding table is [VOCAB_SIZE][EMBED_DIM], we need row v
      w_row = weights + v * EMBED_DIM;
      // But hidden_activations is HIDDEN_DIM. 
      // For tied weights with HIDDEN_DIM != EMBED_DIM, this is incorrect.
      // Simplification: only iterate min(HIDDEN_DIM, EMBED_DIM)
      uint8_t dim = (HIDDEN_DIM < EMBED_DIM) ? HIDDEN_DIM : EMBED_DIM;
      for (uint8_t i = 0; i < dim; i++) {
        acc += (int32_t)hidden_activations[i] * (int32_t)pgm_read_byte(w_row + i);
      }
    } else {
      w_row = weights + v * HIDDEN_DIM;
      for (uint8_t i = 0; i < HIDDEN_DIM; i++) {
        acc += (int32_t)hidden_activations[i] * (int32_t)pgm_read_byte(w_row + i);
      }
    }
    
    // Apply weight scale
    acc = (int32_t)(acc * w_scale);
    
    // Add bias
    int32_t bias = (int32_t)pgm_read_dword(&OUTPUT_BIAS[v]) * b_scale;
    acc += bias;
    
    output_logits[v] = acc;
  }
}

// Full forward pass: context tokens -> logits
static void forward_pass(const uint8_t* context) {
  build_flattened_input(context, flattened_input);
  hidden_layer(flattened_input);
  output_layer();
}

// Argmax with repetition penalty
static uint8_t sample_next_token() {
  // Apply repetition penalty
  for (uint8_t i = 0; i < rep_hist_len; i++) {
    uint8_t token = repetition_history[(rep_hist_pos + i) % REPETITION_WINDOW];
    if (token < VOCAB_SIZE) {
      output_logits[token] -= REPETITION_PENALTY;
    }
  }
  
  // Argmax
  int32_t max_logit = -2147483647L;
  uint8_t best_token = 0;
  
  for (uint16_t v = 0; v < VOCAB_SIZE; v++) {
    if (output_logits[v] > max_logit) {
      max_logit = output_logits[v];
      best_token = v;
    }
  }
  
  return best_token;
}

// Update context window with new token (shift left, append)
static void update_context(uint8_t new_token) {
  // Shift context left
  for (uint8_t i = 1; i < CONTEXT_WINDOW; i++) {
    token_context[i - 1] = token_context[i];
  }
  token_context[CONTEXT_WINDOW - 1] = new_token;
  
  // Update repetition history
  repetition_history[rep_hist_pos] = new_token;
  rep_hist_pos = (rep_hist_pos + 1) % REPETITION_WINDOW;
  if (rep_hist_len < REPETITION_WINDOW) rep_hist_len++;
}

// ============================================================
// GENERATION LOOP
// ============================================================

static void generate_response(const uint8_t* initial_context, uint8_t ctx_len) {
  // Initialize context window (pad with BOS if needed)
  for (uint8_t i = 0; i < CONTEXT_WINDOW; i++) {
    if (i < CONTEXT_WINDOW - ctx_len) {
      token_context[i] = TOKEN_BOS;
    } else {
      token_context[i] = initial_context[i - (CONTEXT_WINDOW - ctx_len)];
    }
  }
  
  // Clear repetition history
  rep_hist_len = 0;
  rep_hist_pos = 0;
  
  Serial.print("AI > ");
  
  uint8_t tokens_generated = 0;
  bool finished = false;
  
  while (!finished && tokens_generated < MAX_OUTPUT_TOKENS) {
    // Forward pass
    forward_pass(token_context);
    
    // Sample next token
    uint8_t next_token = sample_next_token();
    
    // Check for EOS
    if (next_token == TOKEN_EOS) {
      finished = true;
      break;
    }
    
    // Output token
    detokenize(next_token);
    
    // Update state
    update_context(next_token);
    tokens_generated++;
    total_tokens_generated++;
    
    // Small delay to not flood serial
    delay(1);
  }
  
  Serial.println();
}

// ============================================================
// SERIAL COMMANDS
// ============================================================

static void cmd_help() {
  Serial.println(F("========================================"));
  Serial.println(F("UNO-MIND Commands:"));
  Serial.println(F("  /help       - Show this help"));
  Serial.println(F("  /stats      - Model statistics"));
  Serial.println(F("  /model      - Model info"));
  Serial.println(F("  /memory     - Memory usage"));
  Serial.println(F("  /reset      - Reset conversation"));
  Serial.println(F("  /clear      - Clear context"));
  Serial.println(F(""));
  Serial.println(F("Normal text is treated as a prompt."));
  Serial.println(F("========================================"));
}

static void cmd_stats() {
  Serial.println(F("UNO-MIND STATS"));
  Serial.println(F("--------------"));
  Serial.print(F("Model: ")); Serial.println(MODEL_NAME);
  Serial.print(F("Version: ")); Serial.println(MODEL_VERSION);
  Serial.print(F("Tokenizer: ")); Serial.println(TOKENIZER_VERSION);
  Serial.print(F("Quantization: ")); Serial.println(QUANTIZATION);
  Serial.println();
  Serial.print(F("Vocab Size: ")); Serial.println(VOCAB_SIZE);
  Serial.print(F("Embed Dim: ")); Serial.println(EMBED_DIM);
  Serial.print(F("Context Window: ")); Serial.println(CONTEXT_WINDOW);
  Serial.print(F("Hidden Dim: ")); Serial.println(HIDDEN_DIM);
  Serial.print(F("Parameters: ")); Serial.println(PARAMETER_COUNT);
  Serial.println();
  Serial.print(F("Tokens Generated: ")); Serial.println(total_tokens_generated);
}

static void cmd_model() {
  Serial.println(F("MODEL INFO"));
  Serial.println(F("----------"));
  Serial.print(F("Name: ")); Serial.println(MODEL_NAME);
  Serial.print(F("Version: ")); Serial.println(MODEL_VERSION);
  Serial.print(F("Tokenizer: ")); Serial.println(TOKENIZER_VERSION);
  Serial.print(F("Quantization: ")); Serial.println(QUANTIZATION);
  Serial.print(F("Vocab: ")); Serial.print(VOCAB_SIZE); Serial.println(F(" tokens"));
  Serial.print(F("Embed: ")); Serial.print(EMBED_DIM); Serial.println(F(" dims"));
  Serial.print(F("Context: ")); Serial.print(CONTEXT_WINDOW); Serial.println(F(" tokens"));
  Serial.print(F("Hidden: ")); Serial.print(HIDDEN_DIM); Serial.println(F(" units"));
  Serial.print(F("Params: ")); Serial.println(PARAMETER_COUNT);
  Serial.print(F("Flash (model): ")); Serial.print(estimate_flash_usage()); Serial.println(F(" bytes"));
  Serial.print(F("SRAM (runtime): ")); Serial.print(estimate_sram_usage()); Serial.println(F(" bytes"));
  Serial.print(F("Max Context: ")); Serial.print(CONTEXT_WINDOW); Serial.println(F(" tokens"));
  Serial.print(F("Max Output: ")); Serial.print(MAX_OUTPUT_TOKENS); Serial.println(F(" tokens"));
}

static void cmd_memory() {
  Serial.println(F("MEMORY USAGE"));
  Serial.println(F("------------"));
  Serial.print(F("Free RAM: ")); Serial.print(freeRam()); Serial.println(F(" bytes"));
  Serial.print(F("Stack Free: ")); Serial.print(checkStack()); Serial.println(F(" bytes"));
  Serial.print(F("Input Buffer: ")); Serial.print(MAX_INPUT_CHARS); Serial.println(F(" bytes"));
  Serial.print(F("Context Buffer: ")); Serial.print(CONTEXT_WINDOW); Serial.println(F(" bytes"));
  Serial.print(F("Inference Scratch: ~")); 
  Serial.print(INPUT_DIM * 2 + HIDDEN_DIM * 4 + VOCAB_SIZE * 4 + 200); 
  Serial.println(F(" bytes"));
  Serial.println();
  Serial.print(F("Flash Used (est): ")); Serial.print(estimate_flash_usage()); Serial.println(F(" bytes"));
  Serial.print(F("Flash Free (est): ")); Serial.print(32768 - 2048 - estimate_flash_usage()); Serial.println(F(" bytes"));
}

static void cmd_reset() {
  total_tokens_generated = 0;
  rep_hist_len = 0;
  rep_hist_pos = 0;
  memset(token_context, 0, CONTEXT_WINDOW);
  Serial.println(F("Conversation reset."));
}

static void cmd_clear() {
  rep_hist_len = 0;
  rep_hist_pos = 0;
  for (uint8_t i = 0; i < CONTEXT_WINDOW; i++) {
    token_context[i] = TOKEN_BOS;
  }
  Serial.println(F("Context cleared."));
}

static void process_command(const char* cmd) {
  if (strcmp(cmd, "/help") == 0) {
    cmd_help();
  } else if (strcmp(cmd, "/stats") == 0) {
    cmd_stats();
  } else if (strcmp(cmd, "/model") == 0) {
    cmd_model();
  } else if (strcmp(cmd, "/memory") == 0) {
    cmd_memory();
  } else if (strcmp(cmd, "/reset") == 0) {
    cmd_reset();
  } else if (strcmp(cmd, "/clear") == 0) {
    cmd_clear();
  } else {
    Serial.print(F("Unknown command: "));
    Serial.println(cmd);
    Serial.println(F("Type /help for commands."));
  }
}

// Flash/SRAM estimation functions
static uint16_t estimate_flash_usage() {
  uint32_t flash = 0;
  flash += VOCAB_SIZE * EMBED_DIM;           // Embedding table
  flash += HIDDEN_DIM * INPUT_DIM;           // Hidden weights
  flash += HIDDEN_DIM * 4;                   // Hidden bias (int32)
  if (!TIE_WEIGHTS) {
    flash += VOCAB_SIZE * HIDDEN_DIM;        // Output weights
  }
  flash += VOCAB_SIZE * 4;                   // Output bias (int32)
  flash += 5 * 4;                            // Scales (float)
  flash += 100;                              // Code + metadata overhead
  return (uint16_t)(flash > 65535 ? 65535 : flash);
}

static uint16_t estimate_sram_usage() {
  uint16_t sram = 0;
  sram += MAX_INPUT_CHARS + 1;               // Input buffer
  sram += CONTEXT_WINDOW;                    // Token context
  sram += REPETITION_WINDOW;                 // Repetition history
  sram += CONTEXT_WINDOW * EMBED_DIM * 2;    // Embedding scratch (int16)
  sram += INPUT_DIM * 2;                     // Flattened input (int16)
  sram += HIDDEN_DIM * 4;                    // Hidden accum (int32)
  sram += HIDDEN_DIM;                        // Hidden activations (int8)
  sram += VOCAB_SIZE * 4;                    // Output logits (int32)
  sram += 200;                               // Temp arithmetic
  sram += 64;                                // Serial buffer
  sram += 300;                               // Stack reserve
  return sram;
}

// ============================================================
// INPUT PROCESSING
// ============================================================

static void normalize_input(char* buf) {
  // Trim whitespace
  char* start = buf;
  while (*start == ' ' || *start == '\t' || *start == '\r' || *start == '\n') start++;
  
  char* end = start + strlen(start) - 1;
  while (end > start && (*end == ' ' || *end == '\t' || *end == '\r' || *end == '\n')) {
    *end-- = '\0';
  }
  
  if (start != buf) {
    memmove(buf, start, strlen(start) + 1);
  }
  
  // Truncate if too long
  if (strlen(buf) > MAX_INPUT_CHARS) {
    buf[MAX_INPUT_CHARS] = '\0';
  }
}

// ============================================================
// SETUP & MAIN LOOP
// ============================================================

void setup() {
  // Initialize serial
  Serial.begin(SERIAL_BAUD);
  
  // Wait for serial (up to 3 seconds)
  uint32_t start = millis();
  while (!Serial && millis() - start < 3000) {
    ; // Wait
  }
  
  // Disable watchdog (in case previous run enabled it)
  wdt_disable();
  
  // Fill stack with pattern for stack checking
  // Note: This is approximate
  uint8_t* p = (uint8_t*)RAMEND;
  while (p > (uint8_t*)0x200) {  // Don't overwrite registers
    *p-- = 0x55;
  }
  
  // Startup banner
  Serial.println();
  Serial.println(F("========================================"));
  Serial.println(F("           UNO-MIND"));
  Serial.println(F("   OFFLINE LOCAL LANGUAGE MODEL"));
  Serial.println(F("========================================"));
  Serial.print(F("Model: ")); Serial.println(MODEL_NAME);
  Serial.print(F("Tokenizer: ")); Serial.println(TOKENIZER_VERSION);
  Serial.print(F("Quantization: ")); Serial.println(QUANTIZATION);
  Serial.println(F("Status: READY"));
  Serial.println();
  Serial.println(F("YOU > "));
}

void loop() {
  // Check for serial input
  if (Serial.available()) {
    // Read line
    int len = Serial.readBytesUntil('\n', input_buffer, MAX_INPUT_CHARS);
    input_buffer[len] = '\0';
    
    // Also consume \r if present
    if (len > 0 && input_buffer[len-1] == '\r') {
      input_buffer[len-1] = '\0';
    }
    
    // Normalize
    normalize_input(input_buffer);
    
    // Empty input
    if (strlen(input_buffer) == 0) {
      Serial.println(F("(empty input)"));
      Serial.print(F("YOU > "));
      return;
    }
    
    // Check for command
    if (input_buffer[0] == '/') {
      process_command(input_buffer);
      Serial.print(F("YOU > "));
      return;
    }
    
    // Tokenize user input
    uint8_t user_tokens[CONTEXT_WINDOW + 10];  // Extra space for long input
    uint8_t user_token_count = tokenize(input_buffer, user_tokens, CONTEXT_WINDOW + 10);
    
    // Truncate if too many tokens (keep last CONTEXT_WINDOW)
    uint8_t ctx_start = 0;
    if (user_token_count > CONTEXT_WINDOW) {
      ctx_start = user_token_count - CONTEXT_WINDOW;
      user_token_count = CONTEXT_WINDOW;
    }
    
    // Generate response
    generate_response(user_tokens + ctx_start, user_token_count);
    
    // Prompt for next input
    Serial.print(F("YOU > "));
  }
  
  // Periodic watchdog reset (if enabled)
  // wdt_reset();
}

// ============================================================
// ERROR HANDLING
// ============================================================

// Handle unexpected crashes (minimal)
extern "C" void __cxa_pure_virtual() {
  while (1) ; // Halt
}